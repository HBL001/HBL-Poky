## install-files/build/conf/bblayers.conf
```bitbake
# this repo is best cloned into poky/meta-custom 
# as you can see you need to clone the meta-* into poky/soures 

# POKY_BBLAYERS_CONF_VERSION is increased each time build/conf/bblayers.conf
# changes incompatibly
POKY_BBLAYERS_CONF_VERSION = "2"

BBPATH = "${TOPDIR}"
BBFILES ?= ""

BBLAYERS ?= " \
  /home/user/poky/meta \
  /home/user/poky/meta-poky \
  /home/user/poky/meta-yocto-bsp \
  /home/user/poky/sources/meta-openembedded/meta-oe \
  /home/user/poky/sources/meta-openembedded/meta-python \
  /home/user/poky/sources/meta-openembedded/meta-networking \
  /home/user/poky/sources/meta-openembedded/meta-filesystems \
  /home/user/poky/sources/meta-virtualization \
  /home/user/poky/sources/meta-ti/meta-beagle \
  /home/user/poky/sources/meta-ti/meta-ti-bsp \
  /home/user/poky/sources/meta-arm/meta-arm \
  /home/user/poky/sources/meta-arm/meta-arm-toolchain \
  /home/user/poky/meta-custom \
  "
```

## install-files/build/conf/local.conf
```bitbake
#
# HBL-001 A billy basic board to make scientific instruments 
# Yocto linux - Scarthgap
#

# Hardware support
MACHINE = "beaglebone-yocto"
#MACHINE ?= "qemuarm"
MACHINE_FEATURES:remove = " kernel-alsa hdmi"
MACHINE_FEATURES:append = " rtc"
KERNEL_DEVICETREE = "am335x-boneblack.dtb"


# Where to place downloads - ${TOPDIR}/../../../..
DL_DIR = "/media/user/1734145a-ed10-4f95-b476-9e5dd16c2249/yocto-build/downloads"
SSTATE_DIR = "/media/user/1734145a-ed10-4f95-b476-9e5dd16c2249/yocto-build/sstate-cache"
TMPDIR = "/media/user/1734145a-ed10-4f95-b476-9e5dd16c2249/yocto-build/tmp"

# Install Docker and SSH onto the Target
IMAGE_INSTALL:append = " dropbear docker docker-compose usb-gadget base-passwd shadow sudo"
IMAGE_INSTALL:remove = " mesa mesa-pvr ti-sgx-ddk-km ti-sgx-ddk-um xf86-video-fbdev xf86-video-modesetting kernel-modules"

# Select the default init manager (systemd)
INIT_MANAGER = "systemd"
VIRTUAL-RUNTIME_init_manager = "systemd"

# Generate a SHA-512 hash for your chosen initial password on your build host:
# $ sudo apt-get install whois   # for mkpasswd
# $ mkpasswd -m sha-512 MyTempPwd
# → e.g. $6$rounds=5000$abc123...$XYZ...
PASSWD = "$6$a7Yb.YWvqQKa5nmw$xEpgiagfZmURLUB.k8PAwimuPqL8/FYM9VjDoHhvD6Uzd5lVBm4C34eA5HCY06nWC39b/WS/5MXLYHfFMGdgZ/"

# Create “user” with home directory, set its password, and expire it immediately
EXTRA_USERS_PARAMS = "\
    useradd -m -p '${PASSWD}' user; \
    usermod  -e 0 user; \
    usermod -a -G sudo user;\
"


# Meego Image Creator
# use the custom version of the beaglebone-yocto.wks that is in meta-custom
WKS_FILES_DIRS:prepend = "${TOPDIR}/meta-custom/wic/files:"
WKS_SEARCH_PATH:prepend = "/home/user/poky/meta-custom/wic/files:"
WKS_FILE = "biobeagle.wks.in"

DISTRO ?= "poky"
DISTRO_FEATURES:remove = "x11 vulkan wayland opengl pulseaudio alsa hdmi"
DISTRO_FEATURES:append = " virtualization vfat"

PACKAGE_CLASSES ?= "package_deb"
SDKMACHINE ?= "x86_64"

INHERIT += "extrausers"

EXTRA_IMAGE_FEATURES ?= "debug-tweaks"

USER_CLASSES ?= "buildstats"

PATCHRESOLVE = "noop"

BB_NUMBER_THREADS = "4"
PARALLEL_MAKE = "-j4"

# Disk Space Monitoring during the build
BB_DISKMON_DIRS ??= "\
    STOPTASKS,${TMPDIR},1G,100K \
    STOPTASKS,${DL_DIR},1G,100K \
    STOPTASKS,${SSTATE_DIR},1G,100K \
    STOPTASKS,/tmp,100M,100K \
    HALT,${TMPDIR},100M,1K \
    HALT,${DL_DIR},100M,1K \
    HALT,${SSTATE_DIR},100M,1K \
    HALT,/tmp,10M,1K"
```

## recipes-kernel/linux/files/ds1302-driver/Kconfig
```kconfig
config RTC_DRV_DS1302_GPIO
	tristate "Dallas DS1302 GPIO"
	help
	  If you say yes here you get support for the Dallas DS1302 RTC chips
	  using GPIO bitbang interface.
```

## recipes-kernel/linux/files/ft800-driver/Kconfig
```kconfig
config FT800_DRIVER
    tristate "FT800 SPI Display Controller Driver"
    depends on SPI
    help
      Stub driver for the Bridgetek FT800 SPI display controller.
      This minimal implementation binds to the device tree node
      and outputs probe/remove logs.
```

## recipes-kernel/linux/linux-yocto/files/ds1302-driver/Kconfig
```kconfig
config RTC_DRV_DS1302_GPIO
	tristate "Dallas DS1302 over GPIO"
	depends on RTC_CLASS
	default yes
	help
	  Support for the Dallas DS1302 RTC chips using GPIO bitbang interface.
```

## recipes-kernel/linux/linux-yocto/files/ft800-driver/Kconfig
```kconfig
# SPDX-License-Identifier: GPL-2.0
menu "FT800 SPI Display Driver"

config FT800
    tristate "Bridgetek FT800 SPI Display Controller"
    depends on SPI
    help
      Select this option to enable support for the Bridgetek FT800 SPI graphics controller.
      This driver performs low-level initialization, display timing setup, and provides
      a /dev/ft800 character device for communicating with the FT800 co-processor
      using ioctl().

endmenu
```

## wic/biobeagle.wks
```
# short-description: Create SD card image for Beaglebone
# long-description: Creates a partitioned SD card image for Beaglebone.
# Boot files are located in the first vfat partition.

part /boot --source bootimg-partition --ondisk mmcblk1 --fstype=vfat --label boot --active --align 8192 --size 16 --sourceparams="loader=u-boot" --use-uuid
part /     --source rootfs --ondisk mmcblk1 --fstype=ext4 --label root --align 8192 --use-uuid
bootloader --ptable msdos --append="console=ttyS0,115200"
```
